## Kconfig
```kconfig
menu "ESP Display Panel Configurations"
    config ESP_PANEL_CONF_FILE_SKIP
        bool "Unckeck this to ignore `ESP_Panel_Conf.h`"
        default y

    config ESP_PANEL_BOARD_FILE_SKIP
        bool "Unckeck this to ignore `ESP_Panel_Board_*.h`"
        default y

    orsource "./src/utils/Kconfig.utils"

    orsource "./src/touch/Kconfig.touch"

    orsource "./src/board/Kconfig.board"

endmenu
```

## src/backlight/Kconfig.in
```kconfig
menu "Backlight"
    config ESP_PANEL_BACKLIGHT_IO
        int "Pin num"
        default 45
        range 0 100

    config ESP_PANEL_BACKLIGHT_ON_LEVEL
        bool "The level to turn on"
        default y

    config ESP_PANEL_BACKLIGHT_IDLE_OFF
        bool "Turn off after initializing the panel"
        default n
        help
            Set to 1 if you want to turn off the backlight after initializing the panel; otherwise, set it to turn on

    config ESP_PANEL_LCD_BL_USE_PWM
        bool "Use PWM to control the brightness"
        default y
endmenu
```

## src/board/Kconfig.board
```kconfig
menu "Board"
    choice
        prompt "Select the board type"
        default ESP_PANEL_IGNORE_BOARD

        config ESP_PANEL_IGNORE_BOARD
            bool "None"
            help
                Enable this option if you are not using a board.

        config ESP_PANEL_USE_SUPPORTED_BOARD
            bool "Supported board"
            help
                Enable this option if you are using a supported board.

        config ESP_PANEL_USE_CUSTOM_BOARD
            bool "Custom board"
            help
                Select this option if you are using a custom board.
    endchoice

    if ESP_PANEL_USE_SUPPORTED_BOARD
        orsource "./Kconfig.board_supported"
    endif

    if ESP_PANEL_USE_CUSTOM_BOARD
        orsource "./Kconfig.board_custom"
    endif

endmenu
```

## src/board/Kconfig.board_supported
```kconfig
choice
    prompt "Select the manufacturer"
    default BOARD_MANUFACTURER_ALL

    config BOARD_MANUFACTURER_ALL
        bool "All"
        help
            Espressif, Elecrow, M5Stack, Shenzhen Jingcai Intelligent, Waveshare

    config BOARD_MANUFACTURER_ESPRESSIF
        bool "Espressif"
        help
            https://www.espressif.com/en/products/devkits

    config BOARD_MANUFACTURER_ELECROW
        bool "Elecrow"
        help
            https://www.elecrow.com

    config BOARD_MANUFACTURER_M5STACK
        bool "M5Stack"
        help
            https://m5stack.com/

    config BOARD_MANUFACTURER_JINGCAI
        bool "Shenzhen Jingcai Intelligent"
        help
            https://www.displaysmodule.com/

    config BOARD_MANUFACTURER_WAVESHARE
        bool "Waveshare"
        help
            https://www.waveshare.com/
endchoice

choice
    prompt "Select a target board"

    if BOARD_MANUFACTURER_ESPRESSIF || BOARD_MANUFACTURER_ALL
        orsource "./espressif/Kconfig.espressif"
    endif

    if BOARD_MANUFACTURER_ELECROW || BOARD_MANUFACTURER_ALL
        orsource "./elecrow/Kconfig.elecrow"
    endif

    if BOARD_MANUFACTURER_M5STACK || BOARD_MANUFACTURER_ALL
        orsource "./m5stack/Kconfig.m5stack"
    endif

    if BOARD_MANUFACTURER_JINGCAI || BOARD_MANUFACTURER_ALL
        orsource "./jingcai/Kconfig.jingcai"
    endif

    if BOARD_MANUFACTURER_WAVESHARE || BOARD_MANUFACTURER_ALL
        orsource "./waveshare/Kconfig.waveshare"
    endif
endchoice
```

## src/board/jingcai/Kconfig.jingcai
```kconfig
config BOARD_ESP32_4848S040C_I_Y_3
    bool "ESP32-4848S040C_I_Y_3"
    help
        https://www.displaysmodule.com/sale-41828962-experience-the-power-of-the-esp32-display-module-sku-esp32-4848s040c-i-y-3.html
```

## src/drivers/audio/Kconfig.audio
```kconfig
menu "Audio"
    config ESP_PANEL_DRIVERS_AUDIO_SAMPLE_RATE
        int "Audio sample rate"
        default 44100
        help
            Sample rate for the audio driver.

    config ESP_PANEL_DRIVERS_AUDIO_CHANNELS
        int "Audio channels"
        default 2
        help
            Number of audio channels.

    menu "Enable used drivers in factory"
        config ESP_PANEL_DRIVERS_AUDIO_USE_ALL
            bool "Use all"
            default n

        if !ESP_PANEL_DRIVERS_AUDIO_USE_ALL
            config ESP_PANEL_DRIVERS_AUDIO_USE_PCM5102
                bool "Use PCM5102"
                default n

            config ESP_PANEL_DRIVERS_AUDIO_USE_MAX98357A
                bool "Use MAX98357A"
                default n
        endif
    endmenu

    config ESP_PANEL_DRIVERS_AUDIO_COMPILE_UNUSED_DRIVERS
        bool "Compile unused drivers"
        default y
        help
            When disabled, code for unused drivers will be excluded to speed up compilation.
            Make sure the driver is not used when this option is disabled.
endmenu
```

## src/utils/Kconfig.utils
```kconfig
menu "Utils"
    config ESP_PANEL_CHECK_RESULT_ASSERT
        bool "Assert on error"
        default n
        help
            If enabled, the driver will assert on error. Otherwise, the driver will return error code on error.

    menu "Log output"
        config ESP_PANEL_ENABLE_LOG
            bool "Enable output debug log"
            default y
            help
                If enabled, the driver will output log for debugging.

        config ESP_PANEL_LOG_BUFFER_SIZE
            int "Buffer size for log messages"
            depends on ESP_PANEL_ENABLE_LOG
            default 256

        choice ESP_PANEL_LOG_LEVEL
            prompt "Log level for all messages"
            depends on ESP_PANEL_ENABLE_LOG
            default ESP_PANEL_LOG_LEVEL_INFO

            config ESP_PANEL_LOG_LEVEL_DEBUG
                bool "Debug"
                help
                    Extra information which is not necessary for normal use (values, pointers, sizes, etc)

            config ESP_PANEL_LOG_LEVEL_INFO
                bool "Info"
                help
                    Information messages which describe the normal flow of events

            config ESP_PANEL_LOG_LEVEL_WARNING
                bool "Warning"
                help
                    Error conditions from which recovery measures have been taken

            config ESP_PANEL_LOG_LEVEL_ERROR
                bool "Error"
                help
                    Critical errors, software module cannot recover on its own
        endchoice

        config ESP_PANEL_LOG_GLOBAL_LEVEL
            int
            default 0 if ESP_PANEL_LOG_LEVEL_DEBUG
            default 1 if ESP_PANEL_LOG_LEVEL_INFO
            default 2 if ESP_PANEL_LOG_LEVEL_WARNING
            default 3 if ESP_PANEL_LOG_LEVEL_ERROR
    endmenu

    menu "Memory"
        choice ESP_PANEL_MEM_GENERAL_ALLOC_TYPE_CHOICE
            prompt "Select general allocation type"
            default ESP_PANEL_MEM_GENERAL_ALLOC_TYPE_STDLIB

            config ESP_PANEL_MEM_GENERAL_ALLOC_TYPE_STDLIB
                bool "Standard library (malloc, free)"

            config ESP_PANEL_MEM_GENERAL_ALLOC_TYPE_ESP
                bool "ESP (heap_caps_malloc, free)"

            config ESP_PANEL_MEM_GENERAL_ALLOC_TYPE_MICROPYTHON
                bool "MicroPython (mp_malloc, mp_free)"

            config ESP_PANEL_MEM_GENERAL_ALLOC_TYPE_CUSTOM
                bool "Custom (`ESP_PANEL_MEM_GENERAL_ALLOC_CUSTOM_MALLOC` and `ESP_PANEL_MEM_GENERAL_ALLOC_CUSTOM_FREE`)"
        endchoice

        config ESP_PANEL_MEM_GENERAL_ALLOC_TYPE
            int
            default 0 if ESP_PANEL_MEM_GENERAL_ALLOC_TYPE_STDLIB
            default 1 if ESP_PANEL_MEM_GENERAL_ALLOC_TYPE_ESP
            default 2 if ESP_PANEL_MEM_GENERAL_ALLOC_TYPE_MICROPYTHON
            default 3 if ESP_PANEL_MEM_GENERAL_ALLOC_TYPE_CUSTOM

        config ESP_PANEL_MEM_GENERAL_ALLOC_CUSTOM_INCLUDE
            string "General custom memory header file"
            depends on ESP_PANEL_MEM_GENERAL_ALLOC_TYPE_CUSTOM
            default "stdlib.h"
    endmenu
endmenu
```

## test_apps/common/sdkconfig.defaults
```kconfig
CONFIG_ESP_TASK_WDT_EN=n
CONFIG_FREERTOS_HZ=1000
CONFIG_COMPILER_CXX_EXCEPTIONS=y

CONFIG_ESP_PANEL_USE_SUPPORTED_BOARD=y
CONFIG_BOARD_MANUFACTURER_ALL=y
```

## test_apps/lcd/rgb/sdkconfig.defaults
```kconfig
CONFIG_SPIRAM=y
CONFIG_SPIRAM_MODE_OCT=y
CONFIG_SPIRAM_FETCH_INSTRUCTIONS=y
CONFIG_SPIRAM_RODATA=y
CONFIG_SPIRAM_SPEED_80M=y
CONFIG_ESP_TASK_WDT_INIT=n
CONFIG_FREERTOS_HZ=1000
```

## test_apps/lvgl_port/main/Kconfig.projbuild
```kconfig
menu "Test Configurations"
    choice LVGL_PORT_AVOID_TEARING_MODE_CHOICE
        prompt "Avoid Tearing Mode"
        depends on SOC_LCD_RGB_SUPPORTED || SOC_MIPI_DSI_SUPPORTED
        default LVGL_PORT_AVOID_TEARING_MODE_NONE

        config LVGL_PORT_AVOID_TEARING_MODE_NONE
            bool "None"

        config LVGL_PORT_AVOID_TEARING_MODE_1
            bool "Mode1: LCD double-buffer & LVGL full-refresh"

        config LVGL_PORT_AVOID_TEARING_MODE_2
            bool "Mode2: LCD triple-buffer & LVGL full-refresh"

        config LVGL_PORT_AVOID_TEARING_MODE_3
            bool "Mode3: LCD double-buffer & LVGL direct-mode (recommended)"
    endchoice

    config LVGL_PORT_AVOID_TEARING_MODE
        int
        default 3 if LVGL_PORT_AVOID_TEARING_MODE_3
        default 2 if LVGL_PORT_AVOID_TEARING_MODE_2
        default 1 if LVGL_PORT_AVOID_TEARING_MODE_1
        default 0 if LVGL_PORT_AVOID_TEARING_MODE_NONE || !SOC_LCD_RGB_SUPPORTED
endmenu
```

## test_apps/sdkconfig.defaults
```kconfig
CONFIG_ESP_CONSOLE_USB_SERIAL_JTAG=y
# CONFIG_ESP_TASK_WDT is not set
CONFIG_FREERTOS_HZ=1000
```

## test_apps/sdkconfig.defaults.esp32_c3_lcdkit
```kconfig
CONFIG_IDF_TARGET="esp32c3"
CONFIG_ESP_CONSOLE_USB_SERIAL_JTAG=y
# CONFIG_ESP_TASK_WDT is not set
CONFIG_FREERTOS_HZ=1000
CONFIG_ESP_PANEL_BOARD_ESP32_C3_LCDKIT=y
```

## test_apps/sdkconfig.defaults.esp32_s3_box
```kconfig
CONFIG_IDF_TARGET="esp32s3"
CONFIG_ESP32S3_DEFAULT_CPU_FREQ_240=y
CONFIG_ESP_CONSOLE_USB_SERIAL_JTAG=y
# CONFIG_ESP_TASK_WDT is not set
CONFIG_FREERTOS_HZ=1000
```

## test_apps/sdkconfig.defaults.esp32_s3_korvo_2
```kconfig
CONFIG_IDF_TARGET="esp32s3"
CONFIG_ESP32S3_DEFAULT_CPU_FREQ_240=y
CONFIG_ESP_CONSOLE_SECONDARY_NONE=y
# CONFIG_ESP_TASK_WDT is not set
CONFIG_FREERTOS_HZ=1000
CONFIG_ESP_PANEL_BOARD_ESP32_S3_KORVO_2=y
```

## test_apps/sdkconfig.defaults.esp32_s3_lcd_ev_board
```kconfig
CONFIG_IDF_TARGET="esp32s3"
CONFIG_ESPTOOLPY_FLASHMODE_QIO=y
CONFIG_ESP32S3_DEFAULT_CPU_FREQ_240=y
CONFIG_ESP32S3_SPIRAM_SUPPORT=y
CONFIG_SPIRAM_MODE_OCT=y
CONFIG_SPIRAM_FETCH_INSTRUCTIONS=y
CONFIG_SPIRAM_RODATA=y
CONFIG_SPIRAM_SPEED_80M=y
CONFIG_ESP_CONSOLE_USB_SERIAL_JTAG=y
# CONFIG_ESP_TASK_WDT is not set
CONFIG_FREERTOS_HZ=1000
CONFIG_ESP_PANEL_BOARD_ESP32_S3_LCD_EV_BOARD=y
```

## test_apps/sdkconfig.defaults.esp32_s3_otg
```kconfig
CONFIG_IDF_TARGET="esp32s3"
CONFIG_ESP_CONSOLE_SECONDARY_NONE=y
# CONFIG_ESP_TASK_WDT is not set
CONFIG_FREERTOS_HZ=1000
CONFIG_ESP_PANEL_BOARD_ESP32_S3_USB_OTG=y
```
